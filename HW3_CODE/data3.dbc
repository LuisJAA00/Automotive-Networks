VERSION ""

NS_ :

BS_:

BU_: New_Node_2 Mc

BO_ 5 D_WindowS: 1 New_Node_2
 SG_ WindowPosition : 0|8@1+ (1,0) [0|15] "" Vector__XXX

BO_ 4 D_LockingS: 1 New_Node_2
 SG_ LockState : 0|1@1+ (1,0) [0|1] "" Vector__XXX

BO_ 3 MC_WindowR: 1 Mc
 SG_ WindowsStatus : 0|2@1+ (1,0) [0|2] "" Vector__XXX

BO_ 2 MC_LockingC: 1 Mc
 SG_ LockRequest : 0|1@1+ (1,0) [0|1] "" Vector__XXX

BO_ 1 MC_IgnitionS: 1 Mc
 SG_ Ignition_Status : 0|1@1+ (1,0) [0|1] "" Vector__XXX

EV_ WindowU: 0 [0|1] "" 0 1 DUMMY_NODE_VECTOR3 Vector__XXX;

EV_ WindowD: 0 [0|1] "" 0 2 DUMMY_NODE_VECTOR3 Vector__XXX;

EV_ Window: 0 [0|21] "" 0 3 DUMMY_NODE_VECTOR3 Vector__XXX;

EV_ LockRsq: 0 [0|1] "" 0 4 DUMMY_NODE_VECTOR3 Vector__XXX;

EV_ ignitionStart: 0 [0|1] "" 0 5 DUMMY_NODE_VECTOR3 Vector__XXX;

EV_ BBE: 0 [0|1] "" 0 6 DUMMY_NODE_VECTOR3 Vector__XXX;

EV_ AAE: 0 [0|1] "" 0 7 DUMMY_NODE_VECTOR3 Vector__XXX;

BA_DEF_  "BusType" STRING ;
BA_DEF_DEF_  "BusType" "CAN";
